## arch/riscv32/soc/riscv-privilege/vexriscv/Kconfig.defconfig.series
```kconfig
if SOC_SERIES_RISCV32_VEXRISCV

config SOC_SERIES
	string
	default "vexriscv"

source "arch/riscv32/soc/riscv-privilege/vexriscv/Kconfig.defconfig.vexriscv_contest_up5kperf"
source "arch/riscv32/soc/riscv-privilege/vexriscv/Kconfig.defconfig.vexriscv_contest_up5karea"
source "arch/riscv32/soc/riscv-privilege/vexriscv/Kconfig.defconfig.vexriscv_contest_igloo2perf"

endif # SOC_SERIES_RISCV32_VEXRISCV
```

## arch/riscv32/soc/riscv-privilege/vexriscv/Kconfig.defconfig.vexriscv_contest_igloo2perf
```kconfig
if SOC_VEXRISCV_CONTEST_IGLOO2PERF

config SOC
	string
	default "vexriscv_contest_igloo2perf"

config RISCV_SOC_INTERRUPT_INIT
	bool
	default y

config RISCV_HAS_CPU_IDLE
	bool
	default n

config RISCV_HAS_PLIC
	bool
	default n

config NUM_IRQS
	int
	default 42

config XIP
	bool
	default y

config RISCV_ROM_BASE_ADDR
	hex
	default 0x00010

config RISCV_ROM_SIZE
	hex
	default 0x04FF0

config RISCV_RAM_BASE_ADDR
	hex
	default	0x05000

config RISCV_RAM_SIZE
	hex
	default 0x03000

config RISCV_MTIME_BASE
	hex
	default 0x70010

config RISCV_MTIMECMP_BASE
	hex
	default 0x70018

config UART_BASE
	hex
	default 0x70000
endif
```

## arch/riscv32/soc/riscv-privilege/vexriscv/Kconfig.defconfig.vexriscv_contest_up5karea
```kconfig
if SOC_VEXRISCV_CONTEST_UP5KAREA

config SOC
	string
	default "vexriscv_contest_up5karea"

config COMPILER_OPT
    string
    default "-march=RV32I"

config RISCV_SOC_INTERRUPT_INIT
	bool
	default y

config RISCV_HAS_CPU_IDLE
	bool
	default n

config RISCV_HAS_PLIC
	bool
	default n

config NUM_IRQS
	int
	default 42

config XIP
	bool
	default y

config RISCV_ROM_BASE_ADDR
	hex
	default 0x00010

config RISCV_ROM_SIZE
	hex
	default 0x07000

config RISCV_RAM_BASE_ADDR
	hex
	default	0x08000

config RISCV_RAM_SIZE
	hex
	default 0x07000

config UART_BASE
	hex
	default 0x70000

config VEXRISCV_TIMER_COUNTER_BASE
    hex
    default 0x70010

config VEXRISCV_TIMER_CMP_BASE
    hex
    default 0x70018
endif
```

## arch/riscv32/soc/riscv-privilege/vexriscv/Kconfig.defconfig.vexriscv_contest_up5kperf
```kconfig
if SOC_VEXRISCV_CONTEST_UP5KPERF

config SOC
	string
	default "vexriscv_contest_up5kperf"

config RISCV_SOC_INTERRUPT_INIT
	bool
	default y

config RISCV_HAS_CPU_IDLE
	bool
	default n

config RISCV_HAS_PLIC
	bool
	default n

config NUM_IRQS
	int
	default 42

config XIP
	bool
	default y

config RISCV_ROM_BASE_ADDR
	hex
	default 0x10000

config RISCV_ROM_SIZE
	hex
	default 0x10000

config RISCV_RAM_BASE_ADDR
	hex
	default	0x00000

config RISCV_RAM_SIZE
	hex
	default 0x10000

config RISCV_MTIME_BASE
	hex
	default 0x70010

config RISCV_MTIMECMP_BASE
	hex
	default 0x70018


config UART_BASE
	hex
	default 0x70000
endif
```

## arch/riscv32/soc/riscv-privilege/vexriscv/Kconfig.soc
```kconfig
choice
prompt "VexRiscv implementation"
depends on SOC_SERIES_RISCV32_VEXRISCV

config SOC_VEXRISCV_CONTEST_UP5KPERF
	bool "VexRiscv SoC"
	select ATOMIC_OPERATIONS_C


config SOC_VEXRISCV_CONTEST_UP5KAREA
	bool "VexRiscv SoC"
	select ATOMIC_OPERATIONS_C


config SOC_VEXRISCV_CONTEST_IGLOO2PERF
	bool "VexRiscv SoC"
	select ATOMIC_OPERATIONS_C

endchoice
```

## arch/riscv32/soc/riscv-privilege/vexriscv_contest/Kconfig.soc
```kconfig
choice
prompt "VexRiscv implementation"
depends on SOC_SERIES_RISCV32_VEXRISCV_CONTEST

config SOC_RISCV32_VEXRISCV_CONTEST
	bool "VexRiscv simulation system implementation"
	select ATOMIC_OPERATIONS_C

endchoice
```

## arch/riscv32/soc/riscv-privilege/vexriscv_contest_fast/Kconfig.series
```kconfig
config SOC_SERIES_RISCV32_VEXRISCV_CONTEST_FAST
	bool "VexRiscv implementation"
	depends on RISCV32
	select SOC_FAMILY_RISCV_PRIVILEGE
	help
	Enable support for VexRiscv
```

## arch/riscv32/soc/riscv-privilege/vexriscv_contest_fast/Kconfig.soc
```kconfig
choice
prompt "VexRiscv implementation"
depends on SOC_SERIES_RISCV32_VEXRISCV_CONTEST_FAST

config SOC_RISCV32_VEXRISCV_CONTEST_FAST
	bool "VexRiscv simulation system implementation"
	select ATOMIC_OPERATIONS_C

endchoice
```

## arch/riscv32/soc/riscv-privilege/vexriscv_sim/Kconfig.defconfig.series
```kconfig
if SOC_SERIES_RISCV32_VEXRISCV_SIM

config SOC_SERIES
	string
	default "vexriscv_sim"

config SYS_CLOCK_HW_CYCLES_PER_SEC
	int
	default 1000000

config RISCV_SOC_INTERRUPT_INIT
	bool
	default y

config RISCV_HAS_CPU_IDLE
	bool
	default n

config RISCV_HAS_PLIC
	bool
	default n

config NUM_IRQS
	int
	default 42

config XIP
	bool
	default n

config RISCV_ROM_BASE_ADDR
	hex
	default 0x80000000

config RISCV_ROM_SIZE
	hex
	default 0x10

config RISCV_RAM_BASE_ADDR
	hex
	default	0x80000010

config RISCV_RAM_SIZE
	hex
	default 0x40000



endif # SOC_SERIES_RISCV32_VEXRISCV_SIM
```

## arch/riscv32/soc/riscv-privilege/vexriscv_sim/Kconfig.series
```kconfig
config SOC_SERIES_RISCV32_VEXRISCV_SIM
	bool "VexRiscv simulation implementation"
	depends on RISCV32
	select SOC_FAMILY_RISCV_PRIVILEGE
	help
	Enable support for VexRiscv simulation
```

## arch/riscv32/soc/riscv-privilege/vexriscv_sim/Kconfig.soc
```kconfig
choice
prompt "VexRiscv simulation implementation"
depends on SOC_SERIES_RISCV32_VEXRISCV_SIM

config SOC_RISCV32_VEXRISCV_SIM
	bool "VexRiscv simulation system implementation"
	select ATOMIC_OPERATIONS_C

endchoice
```

## arch/riscv32/soc/riscv-privilege/vexriscv_up5kSpeed/Kconfig.defconfig.series
```kconfig
if SOC_SERIES_RISCV32_VEXRISCV_UP5KSPEED

config SOC_SERIES
	string
	default "vexriscv_up5kSpeed"

config SYS_CLOCK_HW_CYCLES_PER_SEC
	int
	default 1000000

config RISCV_SOC_INTERRUPT_INIT
	bool
	default y

config RISCV_HAS_CPU_IDLE
	bool
	default n

config RISCV_HAS_PLIC
	bool
	default n

config NUM_IRQS
	int
	default 42

config XIP
	bool
	default y

config RISCV_ROM_BASE_ADDR
	hex
	default 0x80000000

config RISCV_ROM_SIZE
	hex
	default 0x10000

config RISCV_RAM_BASE_ADDR
	hex
	default	0x90000000

config RISCV_RAM_SIZE
	hex
	default 0x10000



endif # SOC_SERIES_RISCV32_VEXRISCV_UP5KSPEED
```

## arch/riscv32/soc/riscv-privilege/vexriscv_up5kSpeed/Kconfig.series
```kconfig
config SOC_SERIES_RISCV32_VEXRISCV_UP5KSPEED
	bool "VexRiscv implementation"
	depends on RISCV32
	select SOC_FAMILY_RISCV_PRIVILEGE
	help
	Enable support for VexRiscv
```

## arch/riscv32/soc/riscv-privilege/vexriscv_up5kSpeed/Kconfig.soc
```kconfig
choice
prompt "VexRiscv implementation"
depends on SOC_SERIES_RISCV32_VEXRISCV_UP5KSPEED

config SOC_RISCV32_VEXRISCV_UP5KSPEED
	bool "VexRiscv simulation system implementation"
	select ATOMIC_OPERATIONS_C

endchoice
```

## boards/riscv32/board_vexriscv_sim/Kconfig.board
```kconfig
config BOARD_VEXRISCV_SIM
	bool "VexRiscv simulator"
	depends on SOC_RISCV32_VEXRISCV_SIM
```

## boards/riscv32/board_vexriscv_sim/board_vexriscv_sim_defconfig
```kconfig
CONFIG_RISCV32=y
CONFIG_SOC_SERIES_RISCV32_VEXRISCV_SIM=y
CONFIG_SOC_RISCV32_VEXRISCV_SIM=y
CONFIG_BOARD_VEXRISCV_SIM=y
CONFIG_CONSOLE=y
CONFIG_SERIAL=y
CONFIG_UART_VEXRISCV_SIM=y



CONFIG_UART_CONSOLE=y
CONFIG_UART_CONSOLE_ON_DEV_NAME="uart0"
CONFIG_PLIC=n
CONFIG_RISCV_MACHINE_TIMER=y
CONFIG_GPIO=n
CONFIG_XIP=n
CONFIG_BOOT_BANNER=y
```

## boards/riscv32/board_vexriscv_up5kspeed/Kconfig.board
```kconfig
config BOARD_VEXRISCV_UP5KSPEED
	bool "VexRiscv"
	depends on SOC_RISCV32_VEXRISCV_UP5KSPEED
```

## boards/riscv32/board_vexriscv_up5kspeed/Kconfig.defconfig
```kconfig
if BOARD_VEXRISCV_UP5KSPEED

config BOARD
	default "board_vexriscv_up5kspeed"

endif
```

## boards/riscv32/board_vexriscv_up5kspeed/board_vexriscv_up5kspeed_defconfig
```kconfig
CONFIG_RISCV32=y
CONFIG_SOC_SERIES_RISCV32_VEXRISCV_UP5KSPEED=y
CONFIG_SOC_RISCV32_VEXRISCV_UP5KSPEED=y
CONFIG_BOARD_VEXRISCV_UP5KSPEED=y
CONFIG_CONSOLE=y
CONFIG_SERIAL=y
CONFIG_UART_VEXRISCV_GPIO=y
CONFIG_UART_CONSOLE=y
CONFIG_UART_CONSOLE_ON_DEV_NAME="uart0"
CONFIG_PLIC=n
CONFIG_RISCV_MACHINE_TIMER=y
CONFIG_GPIO=n
CONFIG_BOOT_BANNER=y
```

## boards/riscv32/vexriscv_contest_fast_up5kev/Kconfig.board
```kconfig
config VEXRISCV_CONTEST_FAST_UP5KEV
	bool "VexRiscv"
	depends on SOC_RISCV32_VEXRISCV_CONTEST_FAST_UP5KEV
```

## boards/riscv32/vexriscv_contest_fast_up5kev/Kconfig.defconfig
```kconfig
if VEXRISCV_CONTEST_FAST_UP5KEV

config BOARD
	default "vexriscv_contest_fast_up5kev"

endif
```

## boards/riscv32/vexriscv_contest_igloo2perf_creative/Kconfig.board
```kconfig
config BOARD_VEXRISCV_CONTEST_IGLOO2PERF_CREATIVE
	bool "VexRiscv"
	depends on SOC_VEXRISCV_CONTEST_IGLOO2PERF
```

## boards/riscv32/vexriscv_contest_igloo2perf_creative/Kconfig.defconfig
```kconfig
if BOARD_VEXRISCV_CONTEST_IGLOO2PERF_CREATIVE

config BOARD
	default "vexriscv_contest_igloo2perf_creative"

endif
```

## boards/riscv32/vexriscv_contest_up5karea_evn/Kconfig.board
```kconfig
config BOARD_VEXRISCV_CONTEST_UP5KAREA_EVN
	bool "VexRiscv"
	depends on SOC_VEXRISCV_CONTEST_UP5KAREA
```
