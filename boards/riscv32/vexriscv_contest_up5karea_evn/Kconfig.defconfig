## boards/riscv32/vexriscv_contest_up5karea_evn/Kconfig.defconfig
```kconfig
if BOARD_VEXRISCV_CONTEST_UP5KAREA_EVN

config BOARD
	default "vexriscv_contest_up5karea_evn"

endif
```

## boards/riscv32/vexriscv_contest_up5karea_evn/vexriscv_contest_up5karea_evn_defconfig
```kconfig
CONFIG_RISCV32=y
CONFIG_SOC_SERIES_RISCV32_VEXRISCV=y
CONFIG_SOC_VEXRISCV_CONTEST_UP5KAREA=y
CONFIG_BOARD_VEXRISCV_CONTEST_UP5KAREA_EVN=y
CONFIG_CONSOLE=y
CONFIG_SERIAL=y
CONFIG_UART_VEXRISCV_CONTEST=y
CONFIG_UART_CONSOLE=y
CONFIG_UART_CONSOLE_ON_DEV_NAME="uart0"
CONFIG_PLIC=n
CONFIG_VEXRISCV_CONTEST_AREA_TIMER=y
CONFIG_GPIO=n
CONFIG_BOOT_BANNER=y
CONFIG_SYS_CLOCK_HW_CYCLES_PER_SEC=12000000
```

## boards/riscv32/vexriscv_contest_up5kperf_evn/Kconfig.board
```kconfig
config BOARD_VEXRISCV_CONTEST_UP5KPERF_EVN
	bool "VexRiscv"
	depends on SOC_VEXRISCV_CONTEST_UP5KPERF
```

## boards/riscv32/vexriscv_contest_up5kperf_evn/Kconfig.defconfig
```kconfig
if BOARD_VEXRISCV_CONTEST_UP5KPERF_EVN

config BOARD
	default "vexriscv_contest_up5kperf_evn"

endif
```

## boards/riscv32/vexriscv_contest_up5kperf_evn/vexriscv_contest_up5kperf_evn_defconfig
```kconfig
CONFIG_RISCV32=y
CONFIG_SOC_SERIES_RISCV32_VEXRISCV=y
CONFIG_SOC_VEXRISCV_CONTEST_UP5KPERF=y
CONFIG_BOARD_VEXRISCV_CONTEST_UP5KPERF_EVN=y
CONFIG_CONSOLE=y
CONFIG_SERIAL=y
CONFIG_UART_VEXRISCV_CONTEST=y
CONFIG_UART_CONSOLE=y
CONFIG_UART_CONSOLE_ON_DEV_NAME="uart0"
CONFIG_PLIC=n
CONFIG_RISCV_MACHINE_TIMER=y
CONFIG_GPIO=n
CONFIG_BOOT_BANNER=y
CONFIG_SYS_CLOCK_HW_CYCLES_PER_SEC=12000000
```

## drivers/serial/Kconfig.vexriscv_contest
```kconfig
menuconfig UART_VEXRISCV_CONTEST
	bool "vexriscv UART driver"
	select SERIAL_HAS_DRIVER
	help
	  Enable the vexriscv UART driver.
```

## drivers/serial/Kconfig.vexriscv_gpio
```kconfig
menuconfig UART_VEXRISCV_GPIO
	bool "vexriscv UART driver"
	select SERIAL_HAS_DRIVER
	help
	  Enable the vexriscv UART driver.
```

## drivers/serial/Kconfig.vexriscv_sim
```kconfig
menuconfig UART_VEXRISCV_SIM
	bool "vexriscv sim UART driver"
	depends on SOC_RISCV32_VEXRISCV_SIM
	select SERIAL_HAS_DRIVER
	help
	  Enable the vexriscv sim UART driver.
```
